VERSION ""

NS_ :

BS_:

BU_: Vector__XXX

CM_ "Generated by CAN Research"
CM_ "Asset: edge101_bench"
CM_ "DBC type: research"
CM_ "Confirmed research signals: 1"
CM_ "Source sessions: 5cf83263c91f"
CM_ "Generator: can-research 0.1.0"

BO_ 2556850711 Prop_PGN26112_SA17_DA72: 8 Vector__XXX
 SG_ Fan_RPM : 32|16@1+ (1,0) [0|65535] "RPM" Vector__XXX
